## ColetaPressao/main/Kconfig.projbuild
```kconfig
menu "ColetaPressao Config"

    config COLETA_PRESSAO_MISO_PIN
        int "MISO Pin"
        default  14
        help 
            Pino MISO do  protocolo SPI

    config COLETA_PRESSAO_MOSI_PIN
        int "MOSI Pin"
        default  13
        help 
            Pino MOSI do  protocolo SPI

    config COLETA_PRESSAO_CLK_PIN
        int "CLK Pin"
        default  2
        help 
            Pino CLK do  protocolo SPI

    config COLETA_PRESSAO_CS_PIN
        int "CS Pin"
        default  5
        help 
            Pino CS do  protocolo SPI

    config COLETA_PRESSAO_SCL_PIN
        int "SCL Pin"
        default 23
        help
            Pino SCL do protocolo I2C

    config COLETA_PRESSAO_SDA_PIN
        int "SDA Pin"
        default 22
        help
            Pino SDA do protocolo I2C

    config COLETA_PRESSAO_BAUD_RATE
        int "BAUD_RATE"
        default 115200
        help
            Baud Rate da comunicação serial

    config COLETA_PRESSAO_TX_PIN
        int "TX_PIN"
        default 1
        help
            Pino do Transmissão do protoloco UART, Pino 1 
            geralmente é o pino conectado a entrada USB do modulo
            Esp32 Dev-Kit module V1.

    config COLETA_PRESSAO_RX_PIN
        int "RX_PIN"
        default 3
        help
            Pino do Recepção do protoloco UART, Pino 3 
            geralmente é o pino conectado a entrada USB do modulo
            Esp32 Dev-Kit module V1.

    config COLETA_PRESSAO_SD_PREFIX_FILE_NAME
        string "PREFIXO do arquivo"
        default "data"
        help
            PREFIXO atrelado ao arquivo. Caso já tenha um arquivo com
            o nome "PREFIXO_0.txt", o programa irá criar um arquivo 
            "PREFIXO_1.txt". Tente colocar um nome curto e sem muitos
            caracteres "especiais" como underlines, e evitar colocar
            caracteres com acentos.

endmenu
```
